## config/west.yml
```yaml
manifest:
  remotes:
    - name: zmkfirmware
      url-base: https://github.com/zmkfirmware
    - name: refil
      url-base: https://github.com/refil
    - name: jlfurlan
      url-base: https://github.com/jlfurlan
  projects:
    - name: zmk
      remote: jlfurlan
      revision: adv360-usb-quiet
      import: app/west.yml
  self:
    path: config
```
